## conf/layer.conf
```bitbake
# We have a conf and classes directory, add to BBPATH
BBPATH .= ":${LAYERDIR}"

# We have recipes-* directories, add to BBFILES
BBFILES += "${LAYERDIR}/recipes-*/*/*.bb \
            ${LAYERDIR}/recipes-*/*/*.bbappend"

BBFILE_COLLECTIONS += "meta-ankaios"
BBFILE_PATTERN_meta-ankaios = "^${LAYERDIR}/"
BBFILE_PRIORITY_meta-ankaios = "6"

LAYERDEPENDS_meta-ankaios = "core"
LAYERSERIES_COMPAT_meta-ankaios = "kirkstone"
```
